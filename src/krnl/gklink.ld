/**        __  _________  _________  _________ /\
 *      __/\_\/\  _____ \/\  _____ \/\   _____\  \
 *     / /:/ /\:\ \___/\ \:\ \___/\ \:\  \___/_   \
 *    / /:/ / _\:\ \  \:\ \:\ \  \:\ \:\_____  \   \
 *   / /:/ / /\ \:\ \  \:\ \:\ \  \:\ \/___/:\  \   \
 *   \ \:\ \//\\ \:\ \__\:\ \:\ \__\:\ \  _\_:\  \   \
 *    \ \:\//_/\\_\:\________\:\________\/\_______\   \   
 *     \ \:\  \//  \/________/\/________/\/_______/   /
 *      \ \:\ //  / GOOS - GO Operating System       /
 *       \ \://  /   c.2006 Andrew F. Hart          /
 *        \_\/__/__________________________________/
 * 
 * ======================================================================
 *  ---------------------------------------
 *  * * * THIS FILE IS NO LONGER USED * * *
 *  replaced by: /gooslink.ld on 2006.06.14
 *  ---------------------------------------
 *  Author: Andrew F. Hart
 *  Date: 2006.04.08
 * =======================================================================
 * 2006.06.12 - added INPUT option to reduce strain on command line
 * -----------------------------------------------------------------------
 */

SEARCH_DIR(dbg\obj);
INPUT("gkstart.o","main.o","cons.o","gdt.o",
      "idt.o","isrs.o","irq.o","pit.o",
      "kb.o","printf.o","readline.o","ci.o",
      "cmos.o"
      );
OUTPUT_FORMAT("binary")
ENTRY(gkstart)
phys = 0x00009000;
SECTIONS
{
	.text phys : AT(phys) {
		code = .;
		*(.text)
		. = ALIGN(4096);
	}
	.data : AT(phys + (data - code)){
		data = .;
		*(.data)
		. = ALIGN(4096);
	}
	.bss : AT(phys + (bss - code))
	{
		bss = .;
		*(.bss)
		. = ALIGN(4096);
	}
	end = .;
}
